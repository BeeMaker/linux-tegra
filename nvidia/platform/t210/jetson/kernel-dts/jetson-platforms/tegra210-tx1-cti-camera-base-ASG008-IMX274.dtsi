/*
 * Copyright (c) 2017, NVIDIA CORPORATION.  All rights reserved.
 *
 * This program is free software; you can redistribute it and/or modify
 * it under the terms of the GNU General Public License as published by
 * the Free Software Foundation; either version 2 of the License, or
 * (at your option) any later version.
 *
 * This program is distributed in the hope that it will be useful, but WITHOUT
 * ANY WARRANTY; without even the implied warranty of MERCHANTABILITY or
 * FITNESS FOR A PARTICULAR PURPOSE.  See the GNU General Public License for
 * more details.
 *
 * You should have received a copy of the GNU General Public License
 * along with this program.  If not, see <http://www.gnu.org/licenses/>.
 */


#define CAM0_RST_L	TEGRA_GPIO(S, 4)
#define CAMERA_I2C_MUX_BUS(x) (0x0B + x)
#define CAMERA_I2C_MUX_BUS2(x) (0x07 + x)

/* camera control gpio definitions */

/ {
	host1x {
		i2c@546c0000 {
			imx274_a@1a {
				/* Define any required hw resources needed by driver */
				/* ie. clocks, io pins, power sources */
                      
                /* imx274 sensor input 24M clock from Tegra */
				clocks = <&tegra_car TEGRA210_CLK_CLK_OUT_3>;
				clock-names = "clk_out_3";
				clock-frequency = <24000000>;
				mclk = "clk_out_3";
                       
                /* imx274 sensor reset gpio from Tegra */
				reset-gpios = <&gpio CAM0_RST_L GPIO_ACTIVE_HIGH>;
						
                vana-supply = <&battery_reg>; 
				vif-supply = <&battery_reg>; 
                vdig-supply = <&battery_reg>; 
			};
        };
    };  
};
